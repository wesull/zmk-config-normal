## boards/shields/azymut_v3/Kconfig.defconfig
```kconfig
if SHIELD_AZYMUT_V3_LEFT

config ZMK_KEYBOARD_NAME
    default "azymut-v3"

config ZMK_SPLIT_ROLE_CENTRAL
    default y

endif # SHIELD_AZYMUT_V3_LEFT

if SHIELD_AZYMUT_V3_LEFT || SHIELD_AZYMUT_V3_RIGHT

config ZMK_SPLIT
    default y

endif # SHIELD_AZYMUT_V3_LEFT || SHIELD_AZYMUT_V3_RIGHT
```

## boards/shields/azymut_v3/Kconfig.shield
```kconfig
config SHIELD_AZYMUT_V3_LEFT
    def_bool $(shields_list_contains,azymut_v3_left)

config SHIELD_AZYMUT_V3_RIGHT
    def_bool $(shields_list_contains,azymut_v3_right)
```

## boards/shields/test_1/Kconfig.defconfig
```kconfig
if SHIELD_TEST_1

config ZMK_KEYBOARD_NAME
    default "test_1"

endif # SHIELD_TEST_1
```

## boards/shields/test_2/Kconfig.defconfig
```kconfig
if SHIELD_TEST_2

config ZMK_KEYBOARD_NAME
    default "test_2"

endif # SHIELD_TEST_2
```
