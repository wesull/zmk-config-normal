## config/west.yml
```yaml
# manifest:
#   #defaults:
#     #revision: v0.3
#   remotes:
#     - name: zmkfirmware
#       url-base: https://github.com/zmkfirmware
#     - name: wdtamagi
#       url-base: https://github.com/wdtamagi

#   projects:
#     - name: zmk
#       remote: zmkfirmware
#       import: app/west.yml
#       revision: main

#     - name: zmk-analog-input-driver
#       remote: badjeff
#       revision: main

#     - name: zmk-driver-analog-stick
#       remote: wdtamagi
#       revision: main
      
#   self:
#     path: config





# fork od badjeffa:
manifest:
  #defaults:
    #revision: v0.3
  remotes:
    - name: zmkfirmware
      url-base: https://github.com/zmkfirmware

    - name: friggeri
      url-base: https://github.com/friggeri

    - name: badjeff
      url-base: https://github.com/badjeff
    # Additional modules containing boards/shields/custom code can be listed here as well
    # See https://docs.zephyrproject.org/3.2.0/develop/west/manifest.html#projects
  projects:
    - name: zmk
      remote: friggeri
      import: app/west.yml
      revision: main


    - name: zmk-analog-input-driver
      remote: badjeff
      revision: main

    - name: zmk-hid-joystick
      remote: badjeff
      revision: main
      
  self:
    path: config


#core ZMK
#   

    # - name: zmk
    #   remote: friggeri
    #   revision: feat/hid-joystick
    #   import: app/west.yml
```
